## app/dts/bindings/behaviors/zmk,behavior-runtime-object.yaml
```yaml
# Copyright (c) 2026 The ZMK Next Contributors
# SPDX-License-Identifier: MIT

description: Runtime-configured behavior object dispatcher

compatible: "zmk,behavior-runtime-object"

include: one_param.yaml
```

## app/dts/bindings/zmk,battery-charger.yaml
```yaml
# Copyright (c) 2026 The ZMK Contributors
# SPDX-License-Identifier: MIT

description: |
  What the board's battery charger can tell ZMK. Select it with the
  zmk,battery-charger chosen node. Every property is optional.

  While external power (USB) is present, the cell sits at charge voltage, so a
  voltage reading says little about how full it is. ZMK then reports the last
  level it measured on battery, and with these properties can do better:
  status-gpios tells charging from full, and charge-current-microamp with
  charge-full-design-microamp-hours lets it estimate the level rising while
  charging.

  ZMK uses it only with CONFIG_ZMK_BATTERY_HOLD_ON_EXTERNAL_POWER.

compatible: "zmk,battery-charger"

properties:
  status-gpios:
    type: phandle-array
    description: |
      Charger status output, asserted while the battery is charging (for
      example the CHG pin of a BQ25101 or MCP73831, active low). With external
      power present and this deasserted, the charge is complete.
      Only native tests cover this so far; it has not been verified on a
      board (the XIAO nRF52840's CHG pin did not report charging).

  charge-current-microamp:
    type: int
    description: Charge current the charger is set to, in microamps.

  charge-full-design-microamp-hours:
    type: int
    description: Battery capacity, in microamp-hours (the same property name as Zephyr's battery binding).
```

## app/module/dts/bindings/test-behaviors/zmk,behavior_runtime_config_idle_check_test.yaml
```yaml
# Copyright (c) 2026 The ZMK Next Contributors
# SPDX-License-Identifier: MIT

description: Runtime Config Idle-Activation Check Test Behavior

compatible: "zmk,behavior-runtime-config-idle-check-test"

include: zero_param.yaml
```

## app/module/dts/bindings/test-behaviors/zmk,behavior_runtime_config_idle_seed_test.yaml
```yaml
# Copyright (c) 2026 The ZMK Next Contributors
# SPDX-License-Identifier: MIT

description: Runtime Config Idle-Activation Seed Test Behavior

compatible: "zmk,behavior-runtime-config-idle-seed-test"

include: zero_param.yaml
```

## app/module/dts/bindings/test-behaviors/zmk,behavior_runtime_config_mod_morph_test.yaml
```yaml
# Copyright (c) 2026 The ZMK Next Contributors
# SPDX-License-Identifier: MIT

description: Runtime Config Mod-Morph Test Behavior

compatible: "zmk,behavior-runtime-config-mod-morph-test"

include: zero_param.yaml
```

## app/module/dts/bindings/test-behaviors/zmk,behavior_runtime_config_persistence_test.yaml
```yaml
# Copyright (c) 2026 The ZMK Next Contributors
# SPDX-License-Identifier: MIT

description: Runtime Config Persistence Test Behavior

compatible: "zmk,behavior-runtime-config-persistence-test"

include: zero_param.yaml
```

## app/module/dts/bindings/test-behaviors/zmk,behavior_runtime_config_resource_limit_test.yaml
```yaml
# Copyright (c) 2026 The ZMK Next Contributors
# SPDX-License-Identifier: MIT

description: Runtime Config Resource Limit Test Behavior

compatible: "zmk,behavior-runtime-config-resource-limit-test"

include: zero_param.yaml
```

## app/src/runtime_config/Kconfig
```kconfig
# Copyright (c) 2026 The ZMK Next Contributors
# SPDX-License-Identifier: MIT

menuconfig ZMK_RUNTIME_CONFIG
    bool "ZMK Next runtime configuration"
    depends on !ZMK_SPLIT || ZMK_SPLIT_ROLE_CENTRAL
    help
      Enable bounded ZMK Next runtime configuration: the snapshot model,
      Studio RPC service, transactional Settings storage, and safe activation
      coordinator. It overlays compiled behavior bindings or runtime objects
      when an active runtime snapshot supplies an override; later phases add
      further advanced behavior engines.

if ZMK_RUNTIME_CONFIG

config ZMK_RUNTIME_MAX_OBJECTS
    int "Maximum runtime objects"
    range 1 255
    default 64
    help
      Fixed capacity for user-defined runtime behavior objects.

config ZMK_RUNTIME_MAX_COMBOS
    int "Maximum runtime combos"
    range 1 255
    default 32
    help
      Fixed capacity for runtime combo definitions.

config ZMK_RUNTIME_MAX_COMBO_KEYS
    int "Maximum keys in one runtime combo"
    range 1 16
    default 5
    help
      Maximum number of logical key positions allowed in one runtime combo.

config ZMK_RUNTIME_MAX_MACRO_STEPS
    int "Maximum runtime macro steps"
    range 1 4096
    default 512
    help
      Fixed capacity for macro instructions across a runtime configuration.

config ZMK_RUNTIME_MAX_PERSISTED_BYTES
    int "Maximum runtime configuration persistence size"
    range 256 65535
    default 4096
    help
      Maximum serialized runtime configuration size. The on-flash format is
      private to the firmware and stored transactionally when persistence is
      enabled.

config ZMK_RUNTIME_MAX_KEYMAP_OVERRIDES
    int "Maximum runtime keymap overrides"
    range 1 4096
    default 256
    help
      Fixed capacity for user-defined bindings that override the compiled
      keymap. Positions are in stock logical-keymap space, independent of the
      selected physical layout.

config ZMK_RUNTIME_CONFIG_RPC
    bool "Expose runtime configuration through Studio RPC"
    depends on ZMK_STUDIO_RPC
    default y
    help
      Expose the ZMK Next Runtime Config subsystem through the existing Studio
      USB serial and BLE transports.

config ZMK_RUNTIME_CONFIG_RPC_MAX_CHUNK_BYTES
    int "Maximum Runtime Config RPC chunk size"
    range 16 1024
    default 128
    help
      Largest RuntimeConfigSnapshot upload chunk accepted by firmware. This
      bounds RAM required for each decoded RPC request; complete snapshots are
      assembled in the fixed serialized-snapshot buffer.

config ZMK_RUNTIME_CONFIG_PERSISTENCE
    bool "Persist Runtime Config snapshots with Zephyr Settings"
    depends on SETTINGS
    default y
    help
      Store validated Runtime Config snapshots in two alternating Settings
      slots. A manifest is written last so an interrupted update leaves the
      prior complete slot recoverable.

config ZMK_RUNTIME_CONFIG_ACTIVATION_IDLE_MS
    int "Runtime Config safe activation idle time (ms)"
    range 1 1000
    default 25
    help
      Require this much continuous keyboard-idle time before a persisted
      Runtime Config generation becomes active. Physical key presses and
      runtime behavior-engine blockers keep the generation pending.

if ZMK_RUNTIME_CONFIG_PERSISTENCE

config ZMK_RUNTIME_CONFIG_SETTINGS_CHUNK_BYTES
    int "Runtime Config Settings payload chunk size"
    range 64 1024
    default 256
    help
      Maximum bytes stored in one Zephyr Settings key. This bounds Settings
      write size while the complete snapshot remains bounded by
      CONFIG_ZMK_RUNTIME_MAX_PERSISTED_BYTES.

endif

endif
```

## app/src/split/bluetooth/Kconfig
```kconfig
# Copyright (c) 2022 The ZMK Contributors
# SPDX-License-Identifier: MIT

if ZMK_SPLIT && ZMK_SPLIT_BLE

menu "BLE Transport"

config ZMK_SPLIT_BLE_PRIORITY
    int "BLE transport priority"
    help
        Lower number priorities transports are favored over higher numbers.

# Added for backwards compatibility. New shields / board should set `ZMK_SPLIT_ROLE_CENTRAL` only.
config ZMK_SPLIT_BLE_ROLE_CENTRAL
    bool
    select ZMK_SPLIT_ROLE_CENTRAL

config ZMK_SPLIT_ROLE_CENTRAL
    select BT_CENTRAL
    select BT_GATT_CLIENT
    select BT_GATT_AUTO_DISCOVER_CCC
    select BT_SCAN_WITH_IDENTITY

# Bump this value needed for concurrent GATT discovery of splits
config BT_ATT_TX_COUNT
    default 10 if ZMK_SPLIT_ROLE_CENTRAL

if ZMK_SPLIT_ROLE_CENTRAL

config ZMK_SPLIT_BLE_CENTRAL_PERIPHERALS
    int "Number of peripherals that will connect to the central."

menuconfig ZMK_SPLIT_BLE_CENTRAL_BATTERY_LEVEL_FETCHING
    bool "Fetch Peripheral Battery Level Info"
    help
      Adds internal support for fetching the battery levels from peripherals
      and generating events in the ZMK eventing system.

if ZMK_SPLIT_BLE_CENTRAL_BATTERY_LEVEL_FETCHING

config ZMK_SPLIT_BLE_CENTRAL_BATTERY_LEVEL_QUEUE_SIZE
    int "Max number of battery level events to queue when received from peripherals"
    default ZMK_SPLIT_BLE_CENTRAL_PERIPHERALS

config ZMK_SPLIT_BLE_CENTRAL_BATTERY_LEVEL_PROXY
    bool "Proxy Peripheral Battery Level Info"
    help
      Adds support for reporting the battery levels of connected split
      peripherals through an additional Battery Level service.

config ZMK_SPLIT_BLE_CENTRAL_BATTERY_LEVEL_PROXY_SWAP
    bool "Report the peripheral in the primary Battery Service"
    depends on ZMK_SPLIT_BLE_CENTRAL_BATTERY_LEVEL_PROXY
    depends on ZMK_SPLIT_BLE_CENTRAL_PERIPHERALS = 1
    help
      Swap the two Battery Services for a two-half keyboard: the primary BAS
      reports the peripheral, and the additional one reports this central
      half, labeled "Left" with the "main" description. Host battery apps that
      read the primary BAS as the right half and the second one as the left
      half (Mighty Mitts on macOS) then show both halves. Notifications for
      each half are rate-limited to one per second. With
      CONFIG_ZMK_BATTERY_CHARGE_STATUS, the primary BAS's Battery Level Status
      carries the peripheral's charge state.

config ZMK_SPLIT_BLE_CENTRAL_BATTERY_LEVEL_RETAIN
    bool "Keep a peripheral's last battery level while it is disconnected"
    help
      By default a disconnected peripheral's level drops to 0. With this
      option the last level read from it is kept, for Studio and for the
      proxy, until a read after reconnecting replaces it.

endif

config ZMK_SPLIT_BLE_CENTRAL_POSITION_QUEUE_SIZE
    int "Max number of key position state events to queue when received from peripherals"
    default 5

config ZMK_SPLIT_BLE_CENTRAL_SPLIT_RUN_STACK_SIZE
    int "BLE split central write thread stack size"
    default 512

config ZMK_SPLIT_BLE_CENTRAL_SPLIT_RUN_QUEUE_SIZE
    int "Max number of behavior run events to queue to send to the peripheral(s)"
    default 5

config ZMK_SPLIT_BLE_PREF_INT
    int "Connection interval to use for split central/peripheral connection"
    default 6

config ZMK_SPLIT_BLE_PREF_LATENCY
    int "Latency to use for split central/peripheral connection"
    default 30

config ZMK_SPLIT_BLE_PREF_TIMEOUT
    int "Supervision timeout to use for split central/peripheral connection"
    default 400

config ZMK_SPLIT_BLE_IDLE_INT
    int "Connection interval for the split connection while the keyboard is idle"
    default 0
    help
      Interval (in 1.25 ms units) to switch the split connections to when the
      keyboard goes idle (CONFIG_ZMK_IDLE_TIMEOUT). The central sends on every
      connection event, so a slower interval while nothing is typed saves most
      of its split radio power. The first key press switches back to
      CONFIG_ZMK_SPLIT_BLE_PREF_INT; until that takes effect (a few idle
      intervals), keys from the peripheral arrive at the idle interval.
      If the latency would not fit the supervision timeout at this interval,
      the latency is lowered. 0 keeps CONFIG_ZMK_SPLIT_BLE_PREF_INT always.

config ZMK_SPLIT_BLE_IDLE_LATENCY
    int "Peripheral latency for the split connection while the keyboard is idle"
    depends on ZMK_SPLIT_BLE_IDLE_INT > 0
    default ZMK_SPLIT_BLE_PREF_LATENCY
    help
      Connection events the peripheral may sleep through at the idle interval.
      A long sleep before the switch back to the fast interval can lose the
      link (seen with the Zephyr controller at 60 ms and latency 30: the link
      dropped right after most switches back). A small value keeps the
      peripheral listening often enough while still saving the central's power,
      which does not depend on the latency.

      Switching back from the idle interval has dropped the split link about
      a second later with Zephyr's controller in ZMK's Zephyr v4.1.0
      (zmkfirmware/zephyr v4.1.0+zmk-fixes): it does not restart the
      supervision countdown at the connection update instant. The fix is on
      rleyvasal/zephyr v4.1.0+zmk-fixes+supervision-reset (ae038c05); use it
      until it is upstream.

endif # ZMK_SPLIT_ROLE_CENTRAL

if !ZMK_SPLIT_ROLE_CENTRAL

config ZMK_SPLIT_BLE_PERIPHERAL_STACK_SIZE
    int "BLE split peripheral notify thread stack size"
    default 756

config ZMK_SPLIT_BLE_PERIPHERAL_PRIORITY
    int "BLE split peripheral notify thread priority"
    default 5

config ZMK_SPLIT_BLE_PERIPHERAL_POSITION_QUEUE_SIZE
    int "Max number of key position state events to queue to send to the central"
    default 10

config BT_MAX_PAIRED
    default 1

config BT_MAX_CONN
    default 1

# Allow central to specify connection parameters.
config BT_GAP_AUTO_UPDATE_CONN_PARAMS
    default n

endif # !ZMK_SPLIT_ROLE_CENTRAL

if ZMK_INPUT_SPLIT

config ZMK_INPUT_SPLIT_MSG_QUEUE_SIZE
    int "Max number of input split messages to queue for sending over BLE"
    default 32
    help
      Sets the maximum number of input split events that can be queued for BLE notifications.
      Increasing this reduces drops during high-rate input bursts at the cost of additional RAM.

endif # ZMK_INPUT_SPLIT

endmenu

endif # ZMK_SPLIT_BLE
```
